## config/boards/arm/vie65/Kconfig.board
```kconfig
# Zaphod board configuration

# Copyright (c) 2020 Pete Johanson
# SPDX-License-Identifier: MIT

config BOARD_VIE01
	bool "Vie01"
	depends on SOC_NRF52840_QIAA
```
